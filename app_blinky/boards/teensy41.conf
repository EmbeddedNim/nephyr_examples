## app_blinky/boards/teensy41.conf
```kconfig
CONFIG_REBOOT=y

CONFIG_SOC_MIMXRT1062=y
CONFIG_SOC_SERIES_IMX_RT=y
CONFIG_DEVICE_CONFIGURATION_DATA=n
CONFIG_BOARD_TEENSY41=y
CONFIG_PINMUX=y
CONFIG_CONSOLE=y
CONFIG_UART_CONSOLE=y
CONFIG_SERIAL=y
CONFIG_SPI=y
CONFIG_CORTEX_M_SYSTICK=y
CONFIG_GPIO=y
CONFIG_SYS_CLOCK_HW_CYCLES_PER_SEC=600000000
CONFIG_ARM_MPU=y
CONFIG_HW_STACK_PROTECTION=y

CONFIG_TEST_RANDOM_GENERATOR=y
CONFIG_HARDWARE_DEVICE_CS_GENERATOR=y

CONFIG_NETWORKING=n

CONFIG_MAIN_STACK_SIZE=16384
```

## app_blinky/build/Kconfig/Kconfig.modules
```kconfig
menu "CANopenNode (/home/user/zephyrproject/modules/lib/canopennode)"
osource "$(ZEPHYR_CANOPENNODE_KCONFIG)"
config ZEPHYR_CANOPENNODE_MODULE
	bool
	default y
endmenu
menu "hal_nordic (/home/user/zephyrproject/modules/hal/nordic)"
osource "$(ZEPHYR_HAL_NORDIC_KCONFIG)"
config ZEPHYR_HAL_NORDIC_MODULE
	bool
	default y
endmenu
menu "hal_nxp (/home/user/zephyrproject/modules/hal/nxp)"
osource "$(ZEPHYR_HAL_NXP_KCONFIG)"
config ZEPHYR_HAL_NXP_MODULE
	bool
	default y
endmenu
menu "loramac-node (/home/user/zephyrproject/modules/lib/loramac-node)"
osource "$(ZEPHYR_LORAMAC_NODE_KCONFIG)"
config ZEPHYR_LORAMAC_NODE_MODULE
	bool
	default y
endmenu
menu "lz4 (/home/user/zephyrproject/modules/lib/lz4)"
osource "$(ZEPHYR_LZ4_KCONFIG)"
config ZEPHYR_LZ4_MODULE
	bool
	default y
endmenu
menu "mbedtls (/home/user/zephyrproject/modules/crypto/mbedtls)"
osource "$(ZEPHYR_MBEDTLS_KCONFIG)"
config ZEPHYR_MBEDTLS_MODULE
	bool
	default y
endmenu
menu "nanopb (/home/user/zephyrproject/modules/lib/nanopb)"
osource "$(ZEPHYR_NANOPB_KCONFIG)"
config ZEPHYR_NANOPB_MODULE
	bool
	default y
endmenu
menu "sof (/home/user/zephyrproject/modules/audio/sof)"
osource "/home/user/zephyrproject/modules/audio/sof/zephyr/Kconfig"
config ZEPHYR_SOF_MODULE
	bool
	default y
endmenu
menu "tflite-micro (/home/user/zephyrproject/modules/lib/tflite-micro)"
osource "$(ZEPHYR_TFLITE_MICRO_KCONFIG)"
config ZEPHYR_TFLITE_MICRO_MODULE
	bool
	default y
endmenu
menu "TraceRecorder (/home/user/zephyrproject/modules/debug/TraceRecorder)"
osource "/home/user/zephyrproject/modules/debug/TraceRecorder/kernelports/Zephyr/Kconfig"
config ZEPHYR_TRACERECORDER_MODULE
	bool
	default y
endmenu
menu "trusted-firmware-m (/home/user/zephyrproject/modules/tee/tfm)"
osource "$(ZEPHYR_TRUSTED_FIRMWARE_M_KCONFIG)"
config ZEPHYR_TRUSTED_FIRMWARE_M_MODULE
	bool
	default y
endmenu
```

## app_net_rpc/boards/adafruit_feather_nrf52840.conf
```kconfig
CONFIG_BOOTLOADER_MCUBOOT=n
CONFIG_IMG_ENABLE_IMAGE_CHECK=n
CONFIG_REBOOT=y

CONFIG_NET_L2_ETHERNET=y
# CONFIG_ETH_ENC424J600=n

CONFIG_ETH_W5500=y
CONFIG_ETH_W5500_RX_THREAD_STACK_SIZE=8192
CONFIG_ETH_W5500_RX_THREAD_PRIO=2
CONFIG_ETH_W5500_TIMEOUT=100
CONFIG_ETH_W5500_INT_TIMEOUT=30

CONFIG_NET_CONFIG_AUTO_INIT=y

# Network address config
CONFIG_MAIN_STACK_SIZE=16384
# CONFIG_HEAP_MEM_POOL_SIZE=112000

# CONFIG_NET_BUF_LOG_LEVEL_INF=y
# CONFIG_NET_MAX_CONN=6
# CONFIG_NET_MAX_CONTEXTS=6
# CONFIG_NET_PKT_RX_COUNT=32
# CONFIG_NET_PKT_TX_COUNT=32
# CONFIG_NET_BUF_RX_COUNT=40
# CONFIG_NET_BUF_TX_COUNT=40
```

## app_net_rpc/boards/nucleo_h745zi_q_m7.conf
```kconfig
CONFIG_BOOTLOADER_MCUBOOT=n
# CONFIG_MCUBOOT_SIGNATURE_KEY_FILE="bootloader/mcuboot/root-rsa-2048.pem"
# CONFIG_IMG_ENABLE_IMAGE_CHECK=n
CONFIG_REBOOT=y

CONFIG_NETWORKING=y
CONFIG_NET_IPV4=n
CONFIG_NET_IPV6=y
CONFIG_NET_TCP=y
CONFIG_NET_SOCKETS=y
CONFIG_NET_SOCKETS_POSIX_NAMES=y

# CONFIG_NET_CONFIG_AUTO_INIT=y
# Network driver config
# CONFIG_TEST_RANDOM_GENERATOR=y
# CONFIG_NET_DHCPV4=n
CONFIG_NET_CONFIG_AUTO_INIT=n

CONFIG_ETH_W5500=y
CONFIG_ETH_W5500_RX_THREAD_STACK_SIZE=8192
CONFIG_ETH_W5500_RX_THREAD_PRIO=2
CONFIG_ETH_W5500_TIMEOUT=100
CONFIG_ETH_W5500_INT_TIMEOUT=30

CONFIG_HWINFO=y

# Network address config
CONFIG_NET_CONFIG_SETTINGS=y
# CONFIG_NET_CONFIG_NEED_IPV4=y
CONFIG_NET_CONFIG_NEED_IPV6=n

# Networking tweaks
# CONFIG_NET_TCP_TIME_WAIT_DELAY=3

# Network debug config
CONFIG_NET_LOG=y

# CONFIG_NET_CONFIG_MY_IPV4_ADDR="192.168.30.180"

CONFIG_MAIN_STACK_SIZE=16384
CONFIG_HEAP_MEM_POOL_SIZE=128000
```

## app_net_rpc/boards/teensy41.conf
```kconfig
CONFIG_REBOOT=y


# k_sched_time_slice_set
CONFIG_TIMESLICING=y
CONFIG_TIMESLICE_SIZE=1
CONFIG_TIMESLICE_PRIORITY=5

CONFIG_HWINFO=y

# CONFIG_SYS_CLOCK_TICKS_PER_SEC=32768
# CONFIG_SYS_CLOCK_TICKS_PER_SEC=10000

CONFIG_NET_L2_ETHERNET=y

CONFIG_ETH_W5500=y
CONFIG_ETH_W5500_RX_THREAD_STACK_SIZE=8192
CONFIG_ETH_W5500_RX_THREAD_PRIO=2
CONFIG_ETH_W5500_TIMEOUT=100
CONFIG_ETH_W5500_INT_TIMEOUT=10

# CONFIG_DMA_MCUX_EDMA=y

# Network address config
CONFIG_MAIN_STACK_SIZE=16384

# Network debug config
CONFIG_NET_LOG=y

# CONFIG_NET_ROUTE_MCAST is not set
```

## app_rpc_subscriptions/boards/adafruit_feather_nrf52840.conf
```kconfig
CONFIG_REBOOT=y

CONFIG_NETWORKING=n
CONFIG_MAIN_STACK_SIZE=16384
CONFIG_HEAP_MEM_POOL_SIZE=164000
```

## app_rpc_subscriptions/boards/teensy41.conf
```kconfig
CONFIG_REBOOT=y

CONFIG_SOC_MIMXRT1062=y
CONFIG_SOC_SERIES_IMX_RT=y
CONFIG_DEVICE_CONFIGURATION_DATA=n
CONFIG_BOARD_TEENSY41=y
CONFIG_PINMUX=y
CONFIG_CONSOLE=y
CONFIG_UART_CONSOLE=y
CONFIG_SERIAL=y
CONFIG_SPI=y
CONFIG_CORTEX_M_SYSTICK=y
CONFIG_GPIO=y
CONFIG_SYS_CLOCK_HW_CYCLES_PER_SEC=600000000
CONFIG_ARM_MPU=y
CONFIG_HW_STACK_PROTECTION=y

CONFIG_NETWORKING=y
CONFIG_NET_IPV4=y
CONFIG_NET_IPV6=y
CONFIG_NET_TCP=y
CONFIG_NET_SOCKETS=y
CONFIG_NET_SOCKETS_POSIX_NAMES=y

# Network address config
# CONFIG_ETH_MCUX=y
# CONFIG_PHY_DP83825=y
CONFIG_NET_L2_ETHERNET=y
CONFIG_ETH_ENC424J600=y

CONFIG_NET_CONFIG_SETTINGS=y
CONFIG_NET_CONFIG_NEED_IPV4=y
CONFIG_NET_CONFIG_NEED_IPV6=n

CONFIG_NET_CONFIG_AUTO_INIT=y
# Network driver config
CONFIG_TEST_RANDOM_GENERATOR=y
CONFIG_NET_DHCPV4=y

CONFIG_MAIN_STACK_SIZE=16384

# Network debug config
CONFIG_NET_LOG=y

CONFIG_NET_ROUTE_LOG_LEVEL_INF=y
# CONFIG_NET_ROUTE_MCAST is not set

# CONFIG_NET_CONFIG_MY_IPV4_ADDR="10.0.6.86"
# CONFIG_NET_CONFIG_MY_IPV4_GW="10.0.6.254"

CONFIG_NET_CONFIG_MY_IPV4_ADDR="10.0.7.9"
CONFIG_NET_CONFIG_MY_IPV4_GW="10.0.7.0"

# CONFIG_NET_CONFIG_MY_IPV4_ADDR="10.1.1.224"
CONFIG_NET_CONFIG_MY_IPV6_ADDR="2001:db8::6"
```

## app_zephyr_apis/boards/nucleo_h745zi_q_m7.conf
```kconfig
CONFIG_BOOTLOADER_MCUBOOT=n
# CONFIG_MCUBOOT_SIGNATURE_KEY_FILE="bootloader/mcuboot/root-rsa-2048.pem"
CONFIG_REBOOT=y
CONFIG_IMG_ENABLE_IMAGE_CHECK=n

CONFIG_NETWORKING=y
CONFIG_NET_IPV4=y
CONFIG_NET_IPV6=n
CONFIG_NET_TCP=y
CONFIG_NET_SOCKETS=y
CONFIG_NET_SOCKETS_POSIX_NAMES=y
CONFIG_NET_SOCKETPAIR=y
# CONFIG_NET_SOCKETPAIR_BUFFER_SIZE=10

CONFIG_NET_CONFIG_AUTO_INIT=y
# Network driver config
# CONFIG_TEST_RANDOM_GENERATOR=y
CONFIG_NET_DHCPV4=y

# Network address config
CONFIG_NET_CONFIG_SETTINGS=y
CONFIG_NET_CONFIG_NEED_IPV4=y
# CONFIG_NET_CONFIG_NEED_IPV6=y

# Networking tweaks
# CONFIG_NET_TCP_TIME_WAIT_DELAY=3

# Network debug config
CONFIG_NET_LOG=y

# CONFIG_NET_CONFIG_MY_IPV4_ADDR="10.0.6.86"
# CONFIG_NET_CONFIG_PEER_IPV4_ADDR="10.42.0.5"

CONFIG_MAIN_STACK_SIZE=16384
CONFIG_HEAP_MEM_POOL_SIZE=96000
```

## app_zephyr_apis/boards/qemu_cortex_m3.conf
```kconfig
CONFIG_BOOTLOADER_MCUBOOT=n
# CONFIG_MCUBOOT_SIGNATURE_KEY_FILE="bootloader/mcuboot/root-rsa-2048.pem"
CONFIG_REBOOT=y
CONFIG_IMG_ENABLE_IMAGE_CHECK=n

CONFIG_TIMER_RANDOM_GENERATOR=n
CONFIG_TEST_RANDOM_GENERATOR=y

CONFIG_NETWORKING=n

CONFIG_MAIN_STACK_SIZE=16384
CONFIG_HEAP_MEM_POOL_SIZE=65536
```

## blinky/boards/adafruit_feather_nrf52840.conf
```kconfig
CONFIG_BOOTLOADER_MCUBOOT=y
CONFIG_MCUBOOT_SIGNATURE_KEY_FILE="bootloader/mcuboot/root-rsa-2048.pem"
CONFIG_REBOOT=y
CONFIG_IMG_ENABLE_IMAGE_CHECK=y

CONFIG_NETWORKING=y
CONFIG_NET_IPV4=y
CONFIG_NET_IPV6=y
CONFIG_NET_TCP=y
CONFIG_NET_SOCKETS=y
CONFIG_NET_SOCKETS_POSIX_NAMES=y

CONFIG_NET_CONFIG_AUTO_INIT=y
# Network driver config
# CONFIG_TEST_RANDOM_GENERATOR=y
CONFIG_NET_DHCPV4=n

# Network address config
CONFIG_NET_CONFIG_SETTINGS=y
CONFIG_NET_CONFIG_NEED_IPV4=y
CONFIG_NET_CONFIG_NEED_IPV6=n

# Networking tweaks
# CONFIG_NET_TCP_TIME_WAIT_DELAY=3

# Network debug config
CONFIG_NET_LOG=y


# CONFIG_NET_BUF_LOG_LEVEL_WRN=y
# CONFIG_NET_MAX_CONN=6
# CONFIG_NET_MAX_CONTEXTS=3
# CONFIG_NET_PKT_RX_COUNT=8
# CONFIG_NET_PKT_TX_COUNT=8
CONFIG_NET_BUF_RX_COUNT=40
CONFIG_NET_BUF_TX_COUNT=40

CONFIG_NET_ROUTE_LOG_LEVEL_INF=y
# CONFIG_NET_ROUTE_MCAST is not set

# CONFIG_NET_CONFIG_MY_IPV4_ADDR="10.0.6.86"
# CONFIG_NET_CONFIG_MY_IPV4_GW="10.0.6.254"

CONFIG_NET_CONFIG_MY_IPV4_ADDR="10.0.7.9"
CONFIG_NET_CONFIG_MY_IPV4_GW="10.0.7.0"

# CONFIG_NET_CONFIG_MY_IPV4_ADDR="10.1.1.224"
CONFIG_NET_CONFIG_MY_IPV6_ADDR="2001:db8::6"

# CONFIG_NET_IPV6_NBR_CACHE_LOG_LEVEL_DEFAULT is not set
# CONFIG_NET_IPV6_LOG_LEVEL_ERR=y
# CONFIG_NET_IPV6_NBR_CACHE_LOG_LEVEL_ERR=y

# CONFIG_NET_CONFIG_PEER_IPV6_ADDR=""
# CONFIG_NET_IPV6_ND=y
# CONFIG_NET_IPV6_MLD=y
# CONFIG_NET_IPV6_MAX_NEIGHBORS=12
# CONFIG_NET_IF_MCAST_IPV6_ADDR_COUNT=8
# CONFIG_NET_IF_UNICAST_IPV6_ADDR_COUNT=8
# CONFIG_NET_ROUTE_MCAST=n
# CONFIG_NET_MAX_MCAST_ROUTES=n

# CONFIG_NET_CONFIG_MY_IPV4_ADDR="10.0.6.86"
# CONFIG_NET_CONFIG_PEER_IPV4_ADDR="10.42.0.5"

CONFIG_MAIN_STACK_SIZE=16384
# CONFIG_HEAP_MEM_POOL_SIZE=49152
# CONFIG_HEAP_MEM_POOL_SIZE=16384
CONFIG_HEAP_MEM_POOL_SIZE=192000
```

## boards/qemu_x86.conf
```kconfig
CONFIG_BOOTLOADER_MCUBOOT=n
# CONFIG_MCUBOOT_SIGNATURE_KEY_FILE="bootloader/mcuboot/root-rsa-2048.pem"
CONFIG_REBOOT=y
CONFIG_IMG_ENABLE_IMAGE_CHECK=n

CONFIG_NETWORKING=y
CONFIG_NET_IPV4=y
CONFIG_NET_IPV6=n
CONFIG_NET_TCP=y
CONFIG_NET_SOCKETS=y
CONFIG_NET_SOCKETS_POSIX_NAMES=y

CONFIG_NET_CONFIG_AUTO_INIT=y
# Network driver config
# CONFIG_TEST_RANDOM_GENERATOR=y
CONFIG_NET_DHCPV4=y

# Network address config
CONFIG_NET_CONFIG_SETTINGS=y
# CONFIG_NET_CONFIG_NEED_IPV4=y
# CONFIG_NET_CONFIG_NEED_IPV6=y

# Networking tweaks
# CONFIG_NET_TCP_TIME_WAIT_DELAY=3

# Network debug config
CONFIG_NET_LOG=y

# CONFIG_NET_BUF_LOG_LEVEL_WRN=y
# CONFIG_NET_MAX_CONN=3
# CONFIG_NET_MAX_CONTEXTS=3
# CONFIG_NET_PKT_RX_COUNT=8
# CONFIG_NET_PKT_TX_COUNT=8
# CONFIG_NET_BUF_RX_COUNT=10
# CONFIG_NET_BUF_TX_COUNT=10

CONFIG_NET_LOG=y
CONFIG_NET_ROUTE_LOG_LEVEL_INF=y
# CONFIG_NET_ROUTE_MCAST is not set

# CONFIG_NET_CONFIG_MY_IPV4_ADDR="10.0.7.8"
# CONFIG_NET_CONFIG_MY_IPV4_GW="10.0.7.1"
# CONFIG_NET_CONFIG_MY_IPV4_ADDR="10.1.1.224"
# CONFIG_NET_CONFIG_MY_IPV6_ADDR="2001:db8::6"
# CONFIG_NET_IPV6_NBR_CACHE_LOG_LEVEL_DEFAULT is not set
# CONFIG_NET_IPV6_LOG_LEVEL_ERR=y
# CONFIG_NET_IPV6_NBR_CACHE_LOG_LEVEL_ERR=y

# CONFIG_NET_CONFIG_PEER_IPV6_ADDR=""
# CONFIG_NET_IPV6_ND=y
# CONFIG_NET_IPV6_MLD=y
# CONFIG_NET_IPV6_MAX_NEIGHBORS=12
# CONFIG_NET_IF_MCAST_IPV6_ADDR_COUNT=8
# CONFIG_NET_IF_UNICAST_IPV6_ADDR_COUNT=8
# CONFIG_NET_ROUTE_MCAST=n
# CONFIG_NET_MAX_MCAST_ROUTES=n

# CONFIG_NET_CONFIG_MY_IPV4_ADDR="10.0.6.86"
# CONFIG_NET_CONFIG_PEER_IPV4_ADDR="10.42.0.5"

CONFIG_MAIN_STACK_SIZE=16384
CONFIG_HEAP_MEM_POOL_SIZE=65536
```
