
/*
 * Copyright (c) 2020 Vestas Wind Systems A/S
 *
 * SPDX-License-Identifier: Apache-2.0
 */

&mikrobus_spi {
	status = "okay";

	// click_spi2: spi-device@1 {
	// 	compatible = "microchip,mcp3204";
	// 	reg = <0x1>;
	// 	spi-max-frequency = <100000>;
	// 	label = "MCP3201";
	// 	#io-channel-cells = <1>;
	// };


};

// not needed but fixes upstream dts
&mikrobus_i2c {
	status = "okay";
	clock-frequency = <I2C_BITRATE_STANDARD>;
};
